## grepfa-gw-os/conf/bblayers.conf
```bitbake
# POKY_BBLAYERS_CONF_VERSION is increased each time build/conf/bblayers.conf
# changes incompatibly
POKY_BBLAYERS_CONF_VERSION = "2"

BBPATH = "${TOPDIR}"
BBFILES ?= ""

BBLAYERS ?= " \
  /home/vl0011/grepfa-gw/meta \
  /home/vl0011/grepfa-gw/meta-poky \
  /home/vl0011/grepfa-gw/meta-yocto-bsp \
  "
```
